## firmware/sdkconfig.defaults
```kconfig
# ---- 目标 ----
CONFIG_IDF_TARGET="esp32s3"

# ---- Flash：N8R8 = 8MB flash ----
CONFIG_ESPTOOLPY_FLASHSIZE_8MB=y
CONFIG_ESPTOOLPY_FLASHSIZE="8MB"
CONFIG_ESPTOOLPY_FLASHMODE_DIO=y
CONFIG_ESPTOOLPY_FLASHFREQ_80M=y

# ---- PSRAM：N8R8 = 8MB OPI（八线 Octal）----
CONFIG_SPIRAM=y
CONFIG_SPIRAM_MODE_OCT=y
CONFIG_SPIRAM_SPEED_80M=y
CONFIG_SPIRAM_USE_MALLOC=y
CONFIG_SPIRAM_MALLOC_ALWAYSINTERNAL=4096

# ---- 分区表 ----
CONFIG_PARTITION_TABLE_CUSTOM=y
CONFIG_PARTITION_TABLE_CUSTOM_FILENAME="partitions.csv"
CONFIG_PARTITION_TABLE_OFFSET=0x8000

# ---- FreeRTOS ----
CONFIG_FREERTOS_HZ=1000

# ---- 编译器优化 ----
CONFIG_COMPILER_OPTIMIZATION_PERF=y
CONFIG_COMPILER_OPTIMIZATION_ASSERTIONS_ENABLE=y

# ---- CPU ----
CONFIG_ESP_DEFAULT_CPU_FREQ_MHZ_240=y
CONFIG_ESP32S3_DEFAULT_CPU_FREQ_240=y

# ---- OTA 回滚 ----
# 新固件起来后处于「待验证」状态；连上 petd 确认后才算有效，
# 否则超时 bootloader 自动跑回旧固件。
# 注意：这项会改 bootloader —— 第一次上这个固件仍然要整片刷
#（merged-binary.bin），之后才能纯 OTA 升级 app 分区。
CONFIG_BOOTLOADER_APP_ROLLBACK_ENABLE=y

# ---- 看门狗 ----
CONFIG_ESP_TASK_WDT_TIMEOUT_S=10

# ---- 日志 ----
CONFIG_LOG_DEFAULT_LEVEL_INFO=y

# ---- 主任务栈 ----
CONFIG_ESP_MAIN_TASK_STACK_SIZE=8192
```
